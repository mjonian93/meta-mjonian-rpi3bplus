## build_env/conf/bblayers.conf
```bitbake
# POKY_BBLAYERS_CONF_VERSION is increased each time build/conf/bblayers.conf
# changes incompatibly
POKY_BBLAYERS_CONF_VERSION = "2"

BBPATH = "${TOPDIR}"
BBFILES ?= ""

BBLAYERS ?= " \
  /home/mjonian/Projects/raspberry-pi/yocto/sources/poky/meta \
  /home/mjonian/Projects/raspberry-pi/yocto/sources/poky/meta-poky \
  /home/mjonian/Projects/raspberry-pi/yocto/sources/poky/meta-yocto-bsp \
  /home/mjonian/Projects/raspberry-pi/yocto/sources/meta-openembedded/meta-oe \
  /home/mjonian/Projects/raspberry-pi/yocto/sources/meta-openembedded/meta-python \
  /home/mjonian/Projects/raspberry-pi/yocto/sources/meta-openembedded/meta-multimedia \
  /home/mjonian/Projects/raspberry-pi/yocto/sources/meta-openembedded/meta-networking \
  /home/mjonian/Projects/raspberry-pi/yocto/sources/meta-raspberrypi \
  /home/mjonian/Projects/raspberry-pi/yocto/sources/meta-mjonian-rpi3bplus \
  "
```

## conf/layer.conf
```bitbake
# We have a conf and classes directory, add to BBPATH
BBPATH .= ":${LAYERDIR}"

# We have recipes-* directories, add to BBFILES
BBFILES += "${LAYERDIR}/recipes-*/*/*.bb \
            ${LAYERDIR}/recipes-*/*/*.bbappend"

BBFILE_COLLECTIONS += "meta-mjonian-rpi3bplus"
BBFILE_PATTERN_meta-mjonian-rpi3bplus = "^${LAYERDIR}/"
BBFILE_PRIORITY_meta-mjonian-rpi3bplus = "6"

LAYERDEPENDS_meta-mjonian-rpi3bplus = "core"
LAYERSERIES_COMPAT_meta-mjonian-rpi3bplus = "kirkstone langdale"
```
